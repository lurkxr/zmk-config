#include <dt-bindings/zmk/matrix_transform.h>

/ {
    encoder: encoder {
		    compatible = "alps,ec11";
		    label = "ENCODER";
		    a-gpios = <&pro_micro_d 4 (GPIO_ACTIVE_HIGH | GPIO_PULL_UP)>;
        	    b-gpios = <&pro_micro_d 8 (GPIO_ACTIVE_HIGH | GPIO_PULL_UP)>;
		    resolution = <4>;
		    status = "okay";
	   };
	   
	   encoder {
    status = "okay";
	};
	
	sensors {
        compatible = "zmk,keymap-sensors";
        sensors = <&encoder>;
    };
  };
