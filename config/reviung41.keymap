#include <behaviors.dtsi>
#include <dt-bindings/zmk/keys.h>
#include <dt-bindings/zmk/bt.h>

/ {

    keymap {
        compatible = "zmk,keymap";

                default_layer {
            bindings = <
              &kp ESC &kp LEFT_ARROW &kp C_PP &kp RIGHT_ARROW &kp C_MUTE
            >;
            sensor-bindings = <&inc_dec_kp DOWN_ARROW UP_ARROW>;
        };
    };
};
